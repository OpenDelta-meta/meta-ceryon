## conf/machine/9910lx.conf
```bitbake
#
# This is config file for Protek 9910LX
#

KERNELVERSION = "4.0.1"

SOC_FAMILY = "bcm7362"

require conf/machine/include/ceryon-mipsel.inc

PREFERRED_VERSION_linux-ceryon = "${KERNELVERSION}"

MACHINE_ESSENTIAL_EXTRA_RDEPENDS += "\
	ceryon-dvb-modules-7220s \
	"

MACHINE_FEATURES += "textlcd ci 7segment RCA vfdsymbol"

RCNAME = "protek2"
```

## conf/machine/9911lx.conf
```bitbake
#
# This is config file for Protek 9911LX
#

require conf/machine/include/7225s.inc

MACHINE_FEATURES += "vfdsymbol"

RCNAME = "protek2"
```

## conf/machine/e4hd.conf
```bitbake
#
# This is config file for AXAS E4HD
#

require conf/machine/include/7000s.inc

RCTYPE = "24"
```

## conf/machine/e4hdcombo.conf
```bitbake
#
# This is config file for AXAS E4HD Combo
#

require conf/machine/include/7225s.inc

RCNAME = "e4hdcombo"
```

## conf/machine/e4hdhybrid.conf
```bitbake
#
# This is config file for AXAS E4HD Hybrid
#

require conf/machine/include/7000s.inc

IMAGEDIR = "e4hd"

MACHINE_FEATURES += "dvb-c"
```

## conf/machine/e4hdultra.conf
```bitbake
#
# This is config file for AXAS E4HD Ultra 4K
#

require conf/machine/include/ceryon-arm.inc

IMAGEDIR = "e4hd"

RCTYPE = "24"
RCNAME = "e4hdcombo"
```

## conf/machine/include/7000s.inc
```bitbake
require conf/machine/include/ceryon-mipsel.inc

KERNELVERSION = "4.0.1"

SOC_FAMILY = "bcm7362"

PREFERRED_VERSION_linux-ceryon = "${KERNELVERSION}"

MACHINE_ESSENTIAL_EXTRA_RDEPENDS += "\
	ceryon-dvb-modules-7000s \
	"

MACHINE_FEATURES += "AV_JACK vfdsymbol"

STB_PLATFORM = "7000s"

RCNAME ?= "e4hd"
```

## conf/machine/include/7100s.inc
```bitbake
require conf/machine/include/ceryon-mipsel.inc

KERNELVERSION = "4.0.1"

SOC_FAMILY = "bcm7362"

PREFERRED_VERSION_linux-ceryon = "${KERNELVERSION}"

MACHINE_ESSENTIAL_EXTRA_RDEPENDS += "\
	ceryon-dvb-modules-7100s \
	ceryon-lcd \
	"

MACHINE_FEATURES += "colorlcd220 lcd220 ci RCA"

STB_PLATFORM = "7100s"
```

## conf/machine/include/7225s.inc
```bitbake
require conf/machine/include/ceryon-mipsel.inc

KERNELVERSION = "4.10.12"

SOC_FAMILY = "bcm73625"

PREFERRED_VERSION_linux-ceryon= "${KERNELVERSION}"

MACHINE_ESSENTIAL_EXTRA_RDEPENDS += "\
	ceryon-dvb-modules-7225s \
	"

MACHINE_FEATURES += "textlcd ci 7segment dvb-c RCA"

DVBMEDIASINK_CONFIG += "--with-h265 --with-vb6 --with-vb8 --with-spark"

STB_PLATFORM = "7225s"
```

## conf/machine/include/ceryon-arm.inc
```bitbake
require conf/machine/include/ceryon-oem.inc

KERNELVERSION = "4.10.12"

PREFERRED_PROVIDER_virtual/egl = "ceryon-v3ddriver-${MACHINE}" 
PREFERRED_PROVIDER_virtual/libgles2 = "ceryon-v3ddriver-${MACHINE}"

ROOTFS_FILE = "rootfs.tar.bz2"

SOC_FAMILY = "bcm7252s"

MTD_KERNEL = "mmcblk0p2"
MTD_ROOTFS = "mmcblk0p3"
MTD_BOOTFS = "mmcblk0p1"
MTD_BLACK  = "mmcblk0"

MACHINE_FEATURES += "colorlcd220 lcd220 ci dvb-c emmc mmc swap multitranscoding minitv mountboot swap"

MACHINE_ESSENTIAL_EXTRA_RDEPENDS += "\
	ceryon-lcd \
	"

IMAGE_CLASSES += "ceryonemmc_image_multiboot"

DISTRO_FEATURES_remove += "directfb gtk-directfb"

IMAGE_FSTYPES += "ceryonemmc"
IMAGE_ROOTFS_SIZE ?= "589824"

TARGET_ARCH = "arm"
DEFAULTTUNE = "cortexa15hf-neon-vfpv4"

PREFERRED_VERSION_linux-ceryon= "${KERNELVERSION}"
PREFERRED_VERSION_directfb = "1.7.7"

IMAGE_CMD_prepend = " \
	rm -Rf ${IMAGE_ROOTFS}/tmp/*; \
	"

IMAGE_CMD_ceryonemmc_append = " \
	mkdir -p ${DEPLOY_DIR_IMAGE}/${IMAGEDIR}; \
	${@bb.utils.contains("MACHINE_FEATURES", "lcd220", "cp ${DEPLOY_DIR_IMAGE}/lcdwarning220.bin ${DEPLOY_DIR_IMAGE}/${IMAGEDIR}/lcdflashing.bmp;" , "", d)} \
	mv ${DEPLOY_DIR_IMAGE}/${IMAGE_NAME}.emmc.img ${DEPLOY_DIR_IMAGE}/${IMAGEDIR}/disk.img; \
	cd ${IMAGE_ROOTFS}; \
	tar -cvf ${DEPLOY_DIR_IMAGE}/rootfs.tar -C ${IMAGE_ROOTFS} .; \
	mv ${DEPLOY_DIR_IMAGE}/rootfs.tar ${DEPLOY_DIR_IMAGE}/${IMAGEDIR}/rootfs.tar; \
	bzip2 ${DEPLOY_DIR_IMAGE}/${IMAGEDIR}/rootfs.tar; \
	cp ${DEPLOY_DIR_IMAGE}/zImage ${DEPLOY_DIR_IMAGE}/${IMAGEDIR}/${KERNEL_FILE}; \
	echo ${IMAGE_NAME} > ${DEPLOY_DIR_IMAGE}/${IMAGEDIR}/imageversion; \
	rm -f ${DEPLOY_DIR_IMAGE}/*.zip; \
	cd ${DEPLOY_DIR_IMAGE}; \
	zip ${IMAGE_NAME}_recovery_emmc.zip ${IMAGEDIR}/disk.img ${IMAGEDIR}/imageversion; \
	zip ${IMAGE_NAME}_usb.zip ${IMAGEDIR}/imageversion ${IMAGEDIR}/${KERNEL_FILE} ${IMAGEDIR}/${ROOTFS_FILE}; \
	rm -f ${DEPLOY_DIR_IMAGE}/*.ext4; \
	rm -Rf ${IMAGEDIR}; \
	"

require conf/machine/include/tune-cortexa15.inc

MACHINE_ESSENTIAL_EXTRA_RDEPENDS += "\
	ceryon-dvb-modules-${MACHINE} \
	kernel-module-mt7601u \
	firmware-mt7601u \
	"

STB_PLATFORM = "8100s"
```

## conf/machine/include/ceryon-mipsel.inc
```bitbake
require conf/machine/include/ceryon-oem.inc

ROOTFS_FILE = "rootfs.bin"

MTD_KERNEL = "mtd1"
MTD_ROOTFS = "mtd2"

TARGET_ARCH = "mipsel"
DEFAULTTUNE = "mips32el"

KERNEL_IMAGETYPE = "vmlinux"
KERNEL_OUTPUT = "${KERNEL_IMAGETYPE}"
KERNEL_CONSOLE = "ttyS0,115200n8"

IMAGE_FSTYPES ?= "ubi"

MKUBIFS_ARGS = "-m 2048 -e 126976 -c 4096"
UBINIZE_ARGS = "-m 2048 -p 128KiB"

IMAGE_CMD_ubi_prepend = "\
	rm -rf ${IMAGE_ROOTFS}/boot/*; \
	rm -rf ${IMAGE_ROOTFS}/tmp/*; \
	"

IMAGE_CMD_ubi_append = " \
	mkdir -p ${DEPLOY_DIR_IMAGE}/${IMAGEDIR}; \
	${@bb.utils.contains("MACHINE_FEATURES", "lcd220", "cp ${DEPLOY_DIR_IMAGE}/lcdwarning220.bin ${DEPLOY_DIR_IMAGE}/${IMAGEDIR}/lcdwarning.bin;" , "", d)} \
	${@bb.utils.contains("MACHINE_FEATURES", "lcd220", "cp ${DEPLOY_DIR_IMAGE}/lcdwaitkey220.bin ${DEPLOY_DIR_IMAGE}/${IMAGEDIR}/lcdwaitkey.bin;" , "", d)} \
	mv ${IMGDEPLOYDIR}/${IMAGE_NAME}${IMAGE_NAME_SUFFIX}.ubi ${DEPLOY_DIR_IMAGE}/${IMAGEDIR}/${ROOTFS_FILE}; \
	gzip -9c ${DEPLOY_DIR_IMAGE}/vmlinux-${MACHINE}.bin > ${DEPLOY_DIR_IMAGE}/${IMAGEDIR}/${KERNEL_FILE}; \
	echo ${IMAGE_NAME} > ${DEPLOY_DIR_IMAGE}/${IMAGEDIR}/imageversion; \
	echo "rename this file to 'force' to force an update without confirmation" > ${DEPLOY_DIR_IMAGE}/${IMAGEDIR}/noforce; \
	rm -f ${DEPLOY_DIR_IMAGE}/*.zip; \
	cd ${DEPLOY_DIR_IMAGE}; \
	zip ${IMAGE_NAME}_usb.zip ${IMAGEDIR}/*; \
	rm -f ${DEPLOY_DIR_IMAGE}/*.ubi; \
	rm -f ${DEPLOY_DIR_IMAGE}/*.ubifs; \
	rm -Rf ${IMAGEDIR}; \
	"

MACHINE_FEATURES += "blindscan-dvbs blindscan-dvbc"

require conf/machine/include/tune-mips32.inc
```

## conf/machine/include/ceryon-oem.inc
```bitbake
# We know about rtc
MACHINE_FEATURES_BACKFILL_CONSIDERED += "rtc"

BOX_BRAND = "ceryon"

KERNEL_FILE = "kernel.bin"

DVBPROVIDER = "kernel"
DVBSKYPROVIDER = "kernel"

MACHINE_ESSENTIAL_EXTRA_RDEPENDS += "\
	${@bb.utils.contains_any("MACHINE", "e4hdultra protek4k", "", "ceryon-shutdown", d)} \
	gstreamer1.0-plugin-dvbmediasink \
	${@bb.utils.contains("MACHINE_FEATURES", "emmc", "ceryon-resizerootfs" , "", d)} \
	gstreamer1.0-libav \
	"

require conf/machine/include/soc-family.inc

DVBMEDIASINK_CONFIG = "--with-wma --with-wmv --with-pcm --with-dts --with-eac3"

PREFERRED_PROVIDER_virtual/kernel = "linux-ceryon"

PREFERRED_PROVIDER_virtual/blindscan-dvbs = "ceryon-blindscan-utils"
PREFERRED_PROVIDER_virtual/blindscan-dvbc = "ceryon-blindscan-utils"

MACHINE_FEATURES += "alsa hdmicec switchoff videoenhancement blindscan-tbs HDMI"

BOOTLOGO_FILENAME = "splash.bin"

BLINDSCAN_BINARY = "ceryon_blindscan"
```

## conf/machine/mbmicro.conf
```bitbake
#
# This is config file for Miraclebox Premium Micro
#

require conf/machine/include/7000s.inc

IMAGEDIR = "miraclebox/micro"

RCNAME = "miraclebox"
```

## conf/machine/mbmicrov2.conf
```bitbake
#
# This is config file for Miraclebox Premium Micro V2
#

KERNELVERSION = "4.10.12"

SOC_FAMILY = "bcm73625"

require conf/machine/include/ceryon-mipsel.inc

PREFERRED_VERSION_linux-ceryon= "${KERNELVERSION}"

IMAGEDIR = "miraclebox/microv2"

MACHINE_ESSENTIAL_EXTRA_RDEPENDS += "\
	ceryon-dvb-modules-7005s \
	"

DVBMEDIASINK_CONFIG += "--with-h265 --with-vb6 --with-vb8 --with-spark"

MACHINE_FEATURES += "AV_JACK vfdsymbol"

RCNAME = "miraclebox"
```

## conf/machine/odin2hybrid.conf
```bitbake
#
# This is config file for Opticum Odin2 Hybrid
#

KERNELVERSION = "4.0.1"

SOC_FAMILY = "bcm7362"

require conf/machine/include/ceryon-mipsel.inc

PREFERRED_VERSION_linux-ceryon = "${KERNELVERSION}"

IMAGEDIR = "odin2/hybrid"

MACHINE_ESSENTIAL_EXTRA_RDEPENDS += "\
	ceryon-dvb-modules-7300s \
	"

MACHINE_FEATURES += "textlcd ci 7segment dvb-c RCA"

RCNAME = "ax1"
RCIDNUM = "1"
```

## conf/machine/protek4k.conf
```bitbake
#
# This is config file for Protek 4K
#

require conf/machine/include/ceryon-arm.inc

RCTYPE = "26"
RCNAME = "protek2"
```

## conf/machine/sf208.conf
```bitbake
#
# This is config file for Octagon SF208 HD LCD Single
#

require conf/machine/include/7210s.inc

RCNAME = "sf2x8"
```

## conf/machine/sf228.conf
```bitbake
#
# This is config file for Octagon SF228 HD LCD Twin
#

require conf/machine/include/7210s.inc

RCNAME = "sf2x8"
```

## conf/machine/sf238.conf
```bitbake
#
# This is config file for Octagon SF238 HD LCD Twin
#

require conf/machine/include/ceryon-mipsel.inc

KERNELVERSION = "4.10.12"

SOC_FAMILY = "bcm73625"

PREFERRED_VERSION_linux-ceryon= "${KERNELVERSION}"

MACHINE_ESSENTIAL_EXTRA_RDEPENDS += "\
	ceryon-dvb-modules-7215s \
	ceryon-lcd \
	"

MACHINE_FEATURES += "colorlcd220 lcd220 ci RCA"

DVBMEDIASINK_CONFIG += "--with-h265 --with-vb6 --with-vb8 --with-spark"

RCNAME = "sf2x8"
```

## conf/machine/singleboxlcd.conf
```bitbake
#
# This is config file for Red Eagle Singlebox LCD
#

require conf/machine/include/7100s.inc

IMAGEDIR = "redeagle/singleboxlcd"

RCNAME = "red2"
```

## conf/machine/twinboxlcd.conf
```bitbake
#
# This is config file for Red Eagle Twinbox LCD
#

require conf/machine/include/7100s.inc

IMAGEDIR = "redeagle/twinboxlcd"

RCNAME = "red1"
```

## conf/machine/twinboxlcdci5.conf
```bitbake
#
# This is config file for Red Eagle Twinbox LCD CI
#

require conf/machine/include/ceryon-mipsel.inc

KERNELVERSION = "4.10.12"

SOC_FAMILY = "bcm73625"

PREFERRED_VERSION_linux-ceryon= "${KERNELVERSION}"

IMAGEDIR = "redeagle/twinboxlcd"

MACHINE_ESSENTIAL_EXTRA_RDEPENDS += "\
	ceryon-dvb-modules-7105s \
	ceryon-lcd \
	"

MACHINE_FEATURES += "colorlcd220 lcd220 ci RCA"

DVBMEDIASINK_CONFIG += "--with-h265 --with-vb6 --with-vb8 --with-spark"

RCNAME = "red2"
```
